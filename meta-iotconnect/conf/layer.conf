## meta-iotconnect/conf/layer.conf
```bitbake
# We have a conf and classes directory, add to BBPATH
BBPATH .= ":${LAYERDIR}"

# We have recipes-* directories, add to BBFILES
BBFILES += "${LAYERDIR}/recipes-*/*/*.bb \
            ${LAYERDIR}/recipes-*/*/*.bbappend"

BBFILE_COLLECTIONS += "meta-iotconnect"
BBFILE_PATTERN_meta-iotconnect = "^${LAYERDIR}/"
BBFILE_PRIORITY_meta-iotconnect = "6"

LAYERDEPENDS_meta-iotconnect = "core"
LAYERSERIES_COMPAT_meta-iotconnect = "dunfell"

CORE_IMAGE_EXTRA_INSTALL += " kernel-modules"

IMAGE_INSTALL += " ${CORE_IMAGE_EXTRA_INSTALL}"

IMAGE_INSTALL += " curl"
IMAGE_INSTALL += " packagegroup-core-boot"

IMAGE_LINGUAS = " "
```

## meta-myExampleIotconnectLayer/conf/layer.conf
```bitbake
# We have a conf and classes directory, add to BBPATH
BBPATH .= ":${LAYERDIR}"

# We have recipes-* directories, add to BBFILES
BBFILES += "${LAYERDIR}/recipes-*/*/*.bb \
            ${LAYERDIR}/recipes-*/*/*.bbappend"

BBFILE_COLLECTIONS += "meta-myExampleIotconnectLayer"
BBFILE_PATTERN_meta-myExampleIotconnectLayer = "^${LAYERDIR}/"
BBFILE_PRIORITY_meta-myExampleIotconnectLayer = "6"

LAYERDEPENDS_myExampleIotconnectLayer = "core"
#LAYERSERIES_COMPAT_meta-myExampleIotconnectLayer = "kirkstone"
LAYERSERIES_COMPAT_meta-myExampleIotconnectLayer = "hardknott"
```
